## tracing/Kconfig
```kconfig
# Debug configuration options

# Copyright (c) 2015 Wind River Systems, Inc.
# SPDX-License-Identifier: Apache-2.0

config ENABLE_TRACING
	bool "Enabling Tracing"
	select SCHED_LPWORK
	help
	  Enable system tracing. This requires a backend such as SEGGER
	  Systemview to be enabled as well.

if ENABLE_TRACING

choice 
	prompt "Type of timer used"
	default TRACE_TIMESTAMP_REFERENCE_SYSTICK_TIMER

config TRACE_TIMESTAMP_REFERENCE_SYSTICK_TIMER
	bool "Use the system tick to get the timer information"

config TRACE_TIMESTAMP_CUSTOM_BOARD_TIMER_FREERUNER
	bool "Use a specific timer board defined"
	help
	  The timer should be large enough to avoid ISR count.
endchoice

if TRACE_TIMESTAMP_CUSTOM_BOARD_TIMER_FREERUNER
config TRACE_TIMESTAMP_CUSTOM_BOARD_TIMER_RES_US
	int "Resolution of the timer in nano-seconds"
	range 12 10000
	default 100
	help
	  The delta increment that should be set for the ISR.
	  currently it is using the timer 2

config TRACE_TIMESTAMP_CUSTOM_BOARD_TIMER_ID
	int "Counter low-level ID"
	range 1 65535
	default 2
endif

choice
	prompt "Type of Tracing"
	default TRACE_USE_NOCTF

config TRACE_USE_NOCTF
	bool "Print CPU/Memory Usage tracing in console"
	help
	   Enable tracing of the CPU usage.

config TRACE_USE_CTF
	bool "Use CTF Tracing"
	help
	   Enable tracing of the CPU usage.
endchoice

if TRACE_USE_CTF

config TRACE_CTF_CPU_USAGE
	bool "CPU usage info per threads"

config TRACE_CTF_SCHEDULER_INFO
	bool "Scheduler usage info"
	select SCHED_INSTRUMENTATION
	
config TRACE_CTF_MEMORY_STATIC_INFO
	bool "Stack usage info and allocation - do not activate CONFIG_TRACE_CTF_FUNCTIONS_USAGE"

if TRACE_CTF_MEMORY_STATIC_INFO
	config TRACE_CTF_APPLICATION
	bool "Trace the applications stack usage"
	default y
        help
	  This Allows to trace the application
          Can be used in combination with TRACE_CTF_RTOS

	config TRACE_CTF_RTOS
	bool "Trace the RTOS stack usage"
        help
	  This Allows to trace the RTOS.
          Can be used in combination with TRACE_CTF_APPLICATION

	config TRACE_STACK_USAGE_CALLS_CNT_SAMPLING
	int "Static sampling"
	range 0 65535
	default 10
        help
	  This allows the trace to be <<polled>> every n calls
endif

config TRACE_CTF_MEMORY_DYNAMIC_INFO
	select LIBBACKTRACE
	bool "Dynamic allocation usage info"

config TRACE_CTF_COM_USAGE
	bool "Communication usage info bw"

config TRACE_CTF_COM_PACKETS
	bool "Communication packet dump info"
	help
	  To use with caution, it can block hence reduce
	   performance a lot. 

config TRACE_CTF_FUNCTIONS_USAGE
	bool "Function usage info - do not activate CONFIG_TRACE_CTF_MEMORY_USAGE"

if TRACE_CTF_FUNCTIONS_USAGE
	config TRACE_CTF_FUNCTIONS_USAGE_EXCL_PATH 
	string "Instrumentation exlucing path"
	help 
	  Comma separated list of source file path to not instrument

	config TRACE_CTF_FUNCTIONS_USAGE_EXCL_FUNC
	string "Instrumentation exlucing function"
	help 
	  Comma separated list of function to not instrument

	config TRACE_CTF_FUNCTIONS_USAGE_APPLICATION
	bool "Trace only application"

	config TRACE_CTF_FUNCTIONS_USAGE_RTOS
	bool "Trace only the RTOS"
endif

config TRACE_CTF_CTF_TIMER
	bool "Trace function using internal CTF timer auto"

config TRACE_CTF_IRQ
	bool "Trace the IRQ calls"

config TRACE_CTF_PWR_MEASUREMENT
	bool "Allow to generate a trigger on a pin to measure the power"

if TRACE_CTF_PWR_MEASUREMENT 

choice
	prompt "Select the PORT where the GPIO"
	default GPIO_TRIGGER_PORT_G
config GPIO_TRIGGER_PORT_A
	bool "Port A for the trigger"

config GPIO_TRIGGER_PORT_B
	bool "Port B for the trigger"

config GPIO_TRIGGER_PORT_C
	bool "Port C for the trigger"

config GPIO_TRIGGER_PORT_D
	bool "Port D for the trigger"

config GPIO_TRIGGER_PORT_E
	bool "Port E for the trigger"

config GPIO_TRIGGER_PORT_F
	bool "Port F for the trigger"

config GPIO_TRIGGER_PORT_H
	bool "Port H for the trigger"

config GPIO_TRIGGER_PORT_G
	bool "Port G for the trigger"

config GPIO_TRIGGER_PORT_I
	bool "Port I for the trigger"
endchoice

choice
	prompt "Select the PIN where the GPIO"
	default GPIO_TRIGGER_PIN_7
config GPIO_TRIGGER_PIN_0
	bool "Pin 0 for the trigger"

config GPIO_TRIGGER_PIN_1
	bool "Pin 1 for the trigger"

config GPIO_TRIGGER_PIN_2
	bool "Pin 2 for the trigger"

config GPIO_TRIGGER_PIN_3
	bool "Pin 4 for the trigger"

config GPIO_TRIGGER_PIN_4
	bool "Pin 4 for the trigger"

config GPIO_TRIGGER_PIN_5
	bool "Pin 5 for the trigger"

config GPIO_TRIGGER_PIN_6
	bool "Pin 6 for the trigger"

config GPIO_TRIGGER_PIN_7
	bool "Pin 7 for the trigger"

config GPIO_TRIGGER_PIN_8
	bool "Pin 8 for the trigger"

config GPIO_TRIGGER_PIN_9
	bool "Pin 9 for the trigger"

config GPIO_TRIGGER_PIN_10
	bool "Pin 10 for the trigger"

config GPIO_TRIGGER_PIN_11
	bool "Pin 11 for the trigger"

config GPIO_TRIGGER_PIN_12
	bool "Pin 12 for the trigger"

config GPIO_TRIGGER_PIN_13
	bool "Pin 13 for the trigger"

config GPIO_TRIGGER_PIN_14
	bool "Pin 14 for the trigger"

config GPIO_TRIGGER_PIN_15
	bool "Pin 15 for the trigger"
endchoice

endif

endif

choice
	prompt "Tracing backend"
	depends on TRACE_USE_CTF
	default CTF_BACKEND_TRACING_SERIAL

config CTF_BACKEND_TRACING_SERIAL
	bool "Serial "
	help 
	  Use the serial line to transfer the CTF data 

config CTF_BACKEND_ITM
	bool "ITM"
	depends on !ARMV7M_ITMSYSLOG
	help 
	  Use the ITM facilities to transfer the CTF data

endchoice

if CTF_BACKEND_TRACING_SERIAL

choice 
	prompt "Select UART backend"
	default CTF_BACKEND_SERIAL_NONE

config CTF_BACKEND_SERIAL_NONE
	bool "None"
	select DEV_NULL

config CTF_BACKEND_SERIAL_UART1
	bool "U(S)ART1"
	depends on USART1_SERIALDRIVER

config CTF_BACKEND_SERIAL_UART2
	bool "U(S)ART2"
	depends on USART2_SERIALDRIVER

config CTF_BACKEND_SERIAL_UART3
	bool "U(S)ART3"
	depends on USART3_SERIALDRIVER

config CTF_BACKEND_SERIAL_UART4
	bool "U(S)ART4"
	depends on USART4_SERIALDRIVER

config CTF_BACKEND_SERIAL_UART5
	bool "U(S)ART5"
	depends on USART5_SERIALDRIVER

config CTF_BACKEND_SERIAL_UART6
	bool "U(S)ART6"
	depends on USART6_SERIALDRIVER

config CTF_BACKEND_SERIAL_UART7
	bool "U(S)ART7"
	depends on USART7_SERIALDRIVER

endchoice

config CTF_TRACING_BACKEND_UART_NAME
	depends on !CTF_BACKEND_SERIAL_NONE
	default "/dev/ttyS0"
	string "UART device path"

endif

if CTF_BACKEND_ITM
	config CTF_BACKEND_ITM_SWODIV
	 int "ITM SWO diviser"
	 default 1457
endif


config  ASYNC_CTF_TRACING
	 bool "Use Async thread"
	 depends on TRACE_USE_CTF


if ASYNC_CTF_TRACING
	config ASYNC_THREAD_CTF_PRIO
	 int "Async thread prio"
	 default 50

	config ASYNC_THREAD_CTF_STACK
	 int "Async thread stack size"
	 default 2048

	config ASYNC_THREAD_CTF_NAME
	 string "Async thread name"
	 default "tracer"

	config ASYNC_THREAD_CTF_WAIT_THRESHOLD
	 int "Waiting timer before flushing to the output in ms"
         range 0 65535
	 default 100

	config CTF_RING_BUFFER_SIZE
          int "Data ring buffer size"
          depends on TRACE_USE_CTF
          range 32 65536
          default 256	
endif

#menu "Tracing elements"
#source "tracing_element/Kconfig"
#endmenu

endif
```
