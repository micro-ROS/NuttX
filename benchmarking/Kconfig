## benchmarking/Kconfig
```kconfig
comment "Benchmarking"

config MEMORY_BEMCHMARKING
	bool "Heap memory benchmarking"
	default n
	depends on !ARMV7M_ITMSYSLOG
	select LIBBACKTRACE
	---help---
		Enables Heap benchmarking. ITMSYSLOG must be
		deactivated to be able to use it. Indeed the
		heap benchmarking is instrumenting the
		mm_malloc function and uses ITM to print the
		information
```

## configs/olimex-stm32-e407/telemetry/defconfig
```kconfig
CONFIG_HOST_LINUX=y
CONFIG_APPS_DIR="../apps"
CONFIG_BUILD_FLAT=y
CONFIG_INTELHEX_BINARY=y
CONFIG_RAW_BINARY=y
CONFIG_DEBUG_ALERT=y
CONFIG_ARCH_HAVE_STACKCHECK=y
CONFIG_ARCH_HAVE_HEAPCHECK=y
CONFIG_ARCH_HAVE_CUSTOMOPT=y
CONFIG_DEBUG_FULLOPT=y
CONFIG_ARCH_ARM=y
CONFIG_ARCH="arm"
CONFIG_ARCH_CHIP_STM32=y
CONFIG_ARCH_CORTEXM4=y
CONFIG_ARCH_FAMILY="armv7-m"
CONFIG_ARCH_CHIP="stm32"
CONFIG_ARCH_HAVE_FPU=y
CONFIG_ARCH_HAVE_LAZYFPU=y
CONFIG_ARM_HAVE_MPU_UNIFIED=y
CONFIG_ARCH_HAVE_HARDFAULT_DEBUG=y
CONFIG_ARCH_HAVE_MEMFAULT_DEBUG=y
CONFIG_ARMV7M_TOOLCHAIN_GNU_EABIL=y
CONFIG_ARMV7M_HAVE_STACKCHECK=y
CONFIG_ARCH_CHIP_STM32F407ZG=y
CONFIG_STM32_FLASH_CONFIG_DEFAULT=y
CONFIG_STM32_STM32F4XXX=y
CONFIG_STM32_STM32F407=y
CONFIG_STM32_HAVE_CCM=y
CONFIG_STM32_HAVE_OTGFS=y
CONFIG_STM32_HAVE_FSMC=y
CONFIG_STM32_HAVE_IOCOMPENSATION=y
CONFIG_STM32_HAVE_USART3=y
CONFIG_STM32_HAVE_UART4=y
CONFIG_STM32_HAVE_UART5=y
CONFIG_STM32_HAVE_USART6=y
CONFIG_STM32_HAVE_TIM1=y
CONFIG_STM32_HAVE_TIM2=y
CONFIG_STM32_HAVE_TIM3=y
CONFIG_STM32_HAVE_TIM4=y
CONFIG_STM32_HAVE_TIM5=y
CONFIG_STM32_HAVE_TIM6=y
CONFIG_STM32_HAVE_TIM7=y
CONFIG_STM32_HAVE_TIM8=y
CONFIG_STM32_HAVE_TIM9=y
CONFIG_STM32_HAVE_TIM10=y
CONFIG_STM32_HAVE_TIM11=y
CONFIG_STM32_HAVE_TIM12=y
CONFIG_STM32_HAVE_TIM13=y
CONFIG_STM32_HAVE_TIM14=y
CONFIG_STM32_HAVE_ADC2=y
CONFIG_STM32_HAVE_ADC3=y
CONFIG_STM32_HAVE_CAN1=y
CONFIG_STM32_HAVE_CAN2=y
CONFIG_STM32_HAVE_DAC1=y
CONFIG_STM32_HAVE_DAC2=y
CONFIG_STM32_HAVE_RNG=y
CONFIG_STM32_HAVE_ETHMAC=y
CONFIG_STM32_HAVE_I2C2=y
CONFIG_STM32_HAVE_I2C3=y
CONFIG_STM32_HAVE_SPI2=y
CONFIG_STM32_HAVE_SPI3=y
CONFIG_STM32_HAVE_I2S3=y
CONFIG_STM32_DMA2=y
CONFIG_STM32_I2C1=y
CONFIG_STM32_PWR=y
CONFIG_STM32_SDIO=y
CONFIG_STM32_SYSCFG=y
CONFIG_STM32_USART3=y
CONFIG_STM32_I2C=y
CONFIG_STM32_JTAG_SW_ENABLE=y
CONFIG_STM32_CCMEXCLUDE=y
CONFIG_STM32_USART=y
CONFIG_STM32_SERIALDRIVER=y
CONFIG_STM32_USART3_SERIALDRIVER=y
CONFIG_STM32_I2CTIMEOSEC=0
CONFIG_STM32_I2CTIMEOMS=500
CONFIG_STM32_I2CTIMEOTICKS=500
CONFIG_STM32_SDIO_DMAPRIO=0x00010000
CONFIG_ARCH_TOOLCHAIN_GNU=y
CONFIG_ARCH_HAVE_IRQTRIGGER=y
CONFIG_ARCH_DMA=y
CONFIG_ARCH_HAVE_IRQPRIO=y
CONFIG_ARCH_HAVE_VFORK=y
CONFIG_ARCH_HAVE_MPU=y
CONFIG_ARCH_HAVE_PROGMEM=y
CONFIG_ARCH_HAVE_RESET=y
CONFIG_ARCH_HAVE_FETCHADD=y
CONFIG_ARCH_STACKDUMP=y
CONFIG_ARCH_HAVE_RAMVECTORS=y
CONFIG_BOARD_LOOPSPERMSEC=16717
CONFIG_ARCH_HAVE_INTERRUPTSTACK=y
CONFIG_ARCH_INTERRUPTSTACK=0
CONFIG_ARCH_HAVE_HIPRI_INTERRUPT=y
CONFIG_BOOT_RUNFROMFLASH=y
CONFIG_RAM_START=0x20000000
CONFIG_RAM_SIZE=114688
CONFIG_ARCH_BOARD_OLIMEX_STM32E407=y
CONFIG_ARCH_BOARD="olimex-stm32-e407"
CONFIG_ARCH_HAVE_LEDS=y
CONFIG_ARCH_LEDS=y
CONFIG_ARCH_HAVE_BUTTONS=y
CONFIG_ARCH_BUTTONS=y
CONFIG_ARCH_HAVE_IRQBUTTONS=y
CONFIG_DISABLE_OS_API=y
CONFIG_ARCH_HAVE_TICKLESS=y
CONFIG_USEC_PER_TICK=10000
CONFIG_ARCH_HAVE_TIMEKEEPING=y
CONFIG_START_YEAR=2011
CONFIG_START_MONTH=12
CONFIG_START_DAY=6
CONFIG_MAX_WDOGPARMS=2
CONFIG_PREALLOC_WDOGS=16
CONFIG_WDOG_INTRESERVE=4
CONFIG_PREALLOC_TIMERS=4
CONFIG_INIT_ENTRYPOINT=y
CONFIG_USER_ENTRYPOINT="nsh_main"
CONFIG_RR_INTERVAL=200
CONFIG_TASK_NAME_SIZE=31
CONFIG_MAX_TASKS=16
CONFIG_SCHED_WAITPID=y
CONFIG_NPTHREAD_KEYS=4
CONFIG_PTHREAD_MUTEX_ROBUST=y
CONFIG_SCHED_CPULOAD=y
CONFIG_SCHED_CPULOAD_TIMECONSTANT=2
CONFIG_DEV_CONSOLE=y
CONFIG_SDCLONE_DISABLE=y
CONFIG_NFILE_DESCRIPTORS=8
CONFIG_NFILE_STREAMS=8
CONFIG_NAME_MAX=32
CONFIG_BOARD_INITIALIZE=y
CONFIG_BOARD_INITTHREAD=y
CONFIG_BOARD_INITTHREAD_STACKSIZE=2048
CONFIG_BOARD_INITTHREAD_PRIORITY=240
CONFIG_SIG_SIGUSR1=1
CONFIG_SIG_SIGUSR2=2
CONFIG_SIG_SIGALRM=3
CONFIG_SIG_SIGCONDTIMEDOUT=16
CONFIG_SIG_SIGWORK=17
CONFIG_PREALLOC_MQ_MSGS=4
CONFIG_MQ_MAXMSGSIZE=32
CONFIG_SCHED_WORKQUEUE=y
CONFIG_SCHED_HPWORK=y
CONFIG_SCHED_HPNTHREADS=1
CONFIG_SCHED_HPWORKPRIORITY=224
CONFIG_SCHED_HPWORKSTACKSIZE=2048
CONFIG_SCHED_LPWORK=y
CONFIG_SCHED_LPNTHREADS=1
CONFIG_SCHED_LPWORKPRIORITY=50
CONFIG_SCHED_LPWORKSTACKSIZE=2048
CONFIG_IDLETHREAD_STACKSIZE=1024
CONFIG_USERMAIN_STACKSIZE=2048
CONFIG_PTHREAD_STACK_MIN=256
CONFIG_PTHREAD_STACK_DEFAULT=2048
CONFIG_DISABLE_POLL=y
CONFIG_DEV_NULL=y
CONFIG_ARCH_HAVE_I2CRESET=y
CONFIG_I2C=y
CONFIG_ARCH_HAVE_SPI_BITORDER=y
CONFIG_ARCH_HAVE_SDIO=y
CONFIG_ARCH_HAVE_SDIOWAIT_WRCOMPLETE=y
CONFIG_ARCH_HAVE_SDIO_PREFLIGHT=y
CONFIG_MMCSD=y
CONFIG_MMCSD_NSLOTS=1
CONFIG_MMCSD_MULTIBLOCK_DISABLE=y
CONFIG_MMCSD_SDIO=y
CONFIG_SENSORS=y
CONFIG_SENSORS_INA219=y
CONFIG_INA219_I2C_FREQUENCY=400000
CONFIG_SERIAL=y
CONFIG_SERIAL_CONSOLE=y
CONFIG_MCU_SERIAL=y
CONFIG_STANDARD_SERIAL=y
CONFIG_ARCH_HAVE_SERIAL_TERMIOS=y
CONFIG_USART3_SERIAL_CONSOLE=y
CONFIG_USART3_SERIALDRIVER=y
CONFIG_USART3_RXBUFSIZE=128
CONFIG_USART3_TXBUFSIZE=128
CONFIG_USART3_BAUD=115200
CONFIG_USART3_BITS=8
CONFIG_USART3_PARITY=0
CONFIG_USART3_2STOP=0
CONFIG_SYSLOG_WRITE=y
CONFIG_SYSLOG_SERIAL_CONSOLE=y
CONFIG_SYSLOG_CONSOLE=y
CONFIG_FS_READABLE=y
CONFIG_FS_WRITABLE=y
CONFIG_FS_MQUEUE_MPATH="/var/mqueue"
CONFIG_FS_FAT=y
CONFIG_FAT_LCNAMES=y
CONFIG_FAT_LFN=y
CONFIG_FAT_MAXFNAME=32
CONFIG_FS_PROCFS=y
CONFIG_FS_PROCFS_EXCLUDE_ENVIRON=y
CONFIG_NXFONTS_PACKEDMSFIRST=y
CONFIG_MM_REGIONS=2
CONFIG_BUILTIN=y
CONFIG_STDIO_BUFFER_SIZE=64
CONFIG_STDIO_LINEBUFFER=y
CONFIG_NUNGET_CHARS=2
CONFIG_LIBC_LONG_LONG=y
CONFIG_EOL_IS_EITHER_CRLF=y
CONFIG_ARCH_LOWPUTC=y
CONFIG_LIB_RAND_ORDER=1
CONFIG_LIB_HOMEDIR="/"
CONFIG_LIBC_TMPDIR="/tmp"
CONFIG_LIBC_MAX_TMPFILE=32
CONFIG_POSIX_SPAWN_PROXY_STACKSIZE=1024
CONFIG_TASK_SPAWN_DEFAULT_STACKSIZE=2048
CONFIG_ARCH_HAVE_TLS=y
CONFIG_LIB_SENDFILE_BUFSIZE=512
CONFIG_HAVE_CXX=y
CONFIG_LIBDSP_PRECISION=0
CONFIG_BUILTIN_PROXY_STACKSIZE=1024
CONFIG_EXAMPLES_SYSTEM=y
CONFIG_EXAMPLES_SYSTEM_PRIORITY=100
CONFIG_EXAMPLES_SYSTEM_STACKSIZE=2048
CONFIG_EXAMPLES_TELEMETRY=y
CONFIG_EXAMPLES_TELEMETRY_PRIORITY=100
CONFIG_EXAMPLES_TELEMETRY_STACKSIZE=2048
CONFIG_FSUTILS_MKFATFS=y
CONFIG_NSH_LIBRARY=y
CONFIG_NSH_PROMPT_STRING="nsh> "
CONFIG_NSH_CLE=y
CONFIG_NSH_LINELEN=80
CONFIG_NSH_QUOTE=y
CONFIG_NSH_CMDPARMS=y
CONFIG_NSH_MAXARGUMENTS=7
CONFIG_NSH_ARGCAT=y
CONFIG_NSH_NESTDEPTH=3
CONFIG_NSH_BUILTIN_APPS=y
CONFIG_NSH_DISABLE_DATE=y
CONFIG_NSH_DISABLE_LOSMART=y
CONFIG_NSH_DISABLE_PRINTF=y
CONFIG_NSH_DISABLE_TRUNCATE=y
CONFIG_NSH_MMCSDMINOR=0
CONFIG_NSH_MMCSDSLOTNO=0
CONFIG_NSH_CODECS_BUFSIZE=128
CONFIG_NSH_CMDOPT_HEXDUMP=y
CONFIG_NSH_PROC_MOUNTPOINT="/proc"
CONFIG_NSH_FILEIOSIZE=1024
CONFIG_NSH_CONSOLE=y
CONFIG_HAVE_CXXINITIALIZE=y
CONFIG_SYSTEM_CLE=y
CONFIG_SYSTEM_CLE_DEBUGLEVEL=0
CONFIG_SYSTEM_NSH=y
CONFIG_SYSTEM_NSH_PRIORITY=100
CONFIG_SYSTEM_NSH_STACKSIZE=2048
CONFIG_READLINE_HAVE_EXTMATCH=y
CONFIG_SYSTEM_READLINE=y
CONFIG_READLINE_ECHO=y
CONFIG_SYSTEM_SYSTEM=y
CONFIG_SYSTEM_SYSTEM_STACKSIZE=2048
CONFIG_SYSTEM_SYSTEM_PRIORITY=100
```

## configs/olimex-stm32-e407/uros/defconfig
```kconfig
# CONFIG_ARCH_FPU is not set
# CONFIG_NSH_ARGCAT is not set
# CONFIG_NSH_CMDOPT_HEXDUMP is not set
# CONFIG_NSH_CMDPARMS is not set
CONFIG_ARCH="arm"
CONFIG_ARCH_BOARD="olimex-stm32-e407"
CONFIG_ARCH_BOARD_OLIMEX_STM32E407=y
CONFIG_ARCH_BUTTONS=y
CONFIG_ARCH_CHIP_STM32=y
CONFIG_ARCH_CHIP_STM32F407ZG=y
CONFIG_ARCH_STACKDUMP=y
CONFIG_BOARD_LOOPSPERMSEC=16717
CONFIG_BUILTIN=y
CONFIG_EXAMPLES_HELLO=n
CONFIG_EXAMPLES_HELLOXX=n
CONFIG_FS_PROCFS=y
CONFIG_HAVE_CXX=y
CONFIG_HAVE_CXXINITIALIZE=y
CONFIG_INTELHEX_BINARY=y
CONFIG_MAX_TASKS=16
CONFIG_MAX_WDOGPARMS=2
CONFIG_MM_REGIONS=2
CONFIG_NFILE_DESCRIPTORS=8
CONFIG_NFILE_STREAMS=8
CONFIG_NSH_BUILTIN_APPS=y
CONFIG_NSH_FILEIOSIZE=512
CONFIG_NSH_LINELEN=64
CONFIG_NSH_READLINE=y
CONFIG_PREALLOC_MQ_MSGS=4
CONFIG_PREALLOC_TIMERS=4
CONFIG_PREALLOC_WDOGS=16
CONFIG_RAM_SIZE=114688
CONFIG_RAM_START=0x20000000
CONFIG_RAW_BINARY=y
CONFIG_RR_INTERVAL=200
CONFIG_SCHED_WAITPID=y
CONFIG_SDCLONE_DISABLE=y
CONFIG_START_DAY=6
CONFIG_START_MONTH=12
CONFIG_START_YEAR=2011
CONFIG_STM32_JTAG_SW_ENABLE=y
CONFIG_STM32_PWR=y
CONFIG_STM32_USART2=n
CONFIG_SYSTEM_NSH=y
CONFIG_SYSTEM_NSH_CXXINITIALIZE=y
CONFIG_USART2_RXBUFSIZE=128
CONFIG_USART2_SERIAL_CONSOLE=y
CONFIG_USART2_TXBUFSIZE=128
CONFIG_USER_ENTRYPOINT="nsh_main"

# Enable C99 bool type
CONFIG_C99_BOOL8=y

# Enable uClibc++
CONFIG_UCLIBCXX=y

# Enable monotonic clock
CONFIG_CLOCK_MONOTONIC=y

# Enable uROS example
CONFIG_UROS_EXAMPLES=y
CONFIG_UROS_EXAMPLES_PUBLISHER=y
CONFIG_UROS_EXAMPLES_SUBSCRIBER=y

# Select USART3
CONFIG_STM32_USART3=y
CONFIG_USART3_RXBUFSIZE=128
CONFIG_USART3_TXBUFSIZE=512

# Enable TERMIOS
CONFIG_STANDARD_SERIAL=y
CONFIG_SERIAL_TERMIOS=y
CONFIG_DEV_CONSOLE=y

# Enable poll
CONFIG_DISABLE_POLL=n

# Enable UDP/TCP
CONFIG_ARCH_HAVE_NET=y
CONFIG_NET=y
CONFIG_NETDEVICES=y
CONFIG_NETDEV_LATEINIT=y
CONFIG_NET_UDP=y
CONFIG_NET_TCP=y

# Enable uROS
CONFIG_UROS=y

# Enable ACM console
CONFIG_USBDEV=y
CONFIG_STM32_OTGFS=y
CONFIG_CDCACM=y
CONFIG_CDCACM_CONSOLE=y
CONFIG_CDCACM_RXBUFSIZE=256
CONFIG_CDCACM_TXBUFSIZE=256
CONFIG_NO_SERIAL_CONSOLE=y
CONFIG_LIB_BOARDCTL=y
CONFIG_BOARDCTL_USBDEVCTRL=y

# Enable debug
CONFIG_DEBUG_SYMBOLS=y

# Use Nuttx Math lib
CONFIG_LIBM=y
```

## configs/stm32ldiscovery/nsh/defconfig
```kconfig
# CONFIG_DISABLE_PSEUDOFS_OPERATIONS is not set
CONFIG_ARCH="arm"
CONFIG_ARCH_BOARD="stm32ldiscovery"
CONFIG_ARCH_BOARD_STM32L_DISCOVERY=y
CONFIG_ARCH_CHIP_STM32=y
CONFIG_ARCH_CHIP_STM32L152RC=y
CONFIG_ARCH_STACKDUMP=y
CONFIG_BOARD_LATE_INITIALIZE=y
CONFIG_BOARD_INITTHREAD=y
CONFIG_BOARD_LOOPSPERMSEC=2796
CONFIG_BUILTIN=y
CONFIG_DEFAULT_SMALL=y
CONFIG_DISABLE_MQUEUE=y
CONFIG_DISABLE_POLL=y
CONFIG_ELF=y
CONFIG_EXAMPLES_HELLO=y
CONFIG_FS_AUTOMOUNTER=y
CONFIG_FS_PROCFS=y
CONFIG_FS_WRITABLE=y
CONFIG_INTELHEX_BINARY=y
CONFIG_MAX_TASKS=8
CONFIG_MAX_WDOGPARMS=2
CONFIG_MM_SMALL=y
CONFIG_NFILE_DESCRIPTORS=6
CONFIG_NFILE_STREAMS=6
CONFIG_NPTHREAD_KEYS=0
CONFIG_NSH_BUILTIN_APPS=y
CONFIG_NSH_DISABLE_CD=y
CONFIG_NSH_DISABLE_CP=y
CONFIG_NSH_DISABLE_IFCONFIG=y
CONFIG_NSH_DISABLE_IFUPDOWN=y
CONFIG_NSH_DISABLE_MKDIR=y
CONFIG_NSH_DISABLE_PS=y
CONFIG_NSH_DISABLE_RM=y
CONFIG_NSH_DISABLE_RMDIR=y
CONFIG_NSH_DISABLE_UMOUNT=y
CONFIG_NSH_FILEIOSIZE=64
CONFIG_NUNGET_CHARS=0
CONFIG_PREALLOC_TIMERS=0
CONFIG_PREALLOC_WDOGS=4
CONFIG_PSEUDOFS_SOFTLINKS=y
CONFIG_PTHREAD_STACK_DEFAULT=1536
CONFIG_RAM_SIZE=32768
CONFIG_RAM_START=0x20000000
CONFIG_RAW_BINARY=y
CONFIG_RR_INTERVAL=200
CONFIG_SCHED_WAITPID=y
CONFIG_SDCLONE_DISABLE=y
CONFIG_START_DAY=19
CONFIG_START_MONTH=5
CONFIG_START_YEAR=2013
CONFIG_STDIO_DISABLE_BUFFERING=y
CONFIG_STM32_JTAG_SW_ENABLE=y
CONFIG_STM32_PWR=y
CONFIG_STM32_USART1=y
CONFIG_SYSTEM_NSH=y
CONFIG_TASK_NAME_SIZE=0
CONFIG_TASK_SPAWN_DEFAULT_STACKSIZE=1536
CONFIG_USART1_RXBUFSIZE=64
CONFIG_USART1_SERIAL_CONSOLE=y
CONFIG_USART1_TXBUFSIZE=64
CONFIG_USERMAIN_STACKSIZE=1536
CONFIG_USER_ENTRYPOINT="nsh_main"
CONFIG_WDOG_INTRESERVE=0
CONFIG_STM32_MEDIUMPLUSDENSITY=y
```

## libs/libbacktrace/Kconfig
```kconfig
#
# For a description of the syntax of this configuration file,
# see the file kconfig-language.txt in the NuttX tools repository.
#

comment "Backtrace Support"
config LIBBACKTRACE
	bool "Enable backtrace support"
	depends on ARCH_CHIP_STM32
	default n
	---help---
		Enables support for backtrace. It will use an additional
		~5KBytes of memory. Needed for memory benchmarking.
```
